## application/boards/arm/cioszhong_psu/Kconfig.cioszhong_psu
```kconfig
# CiosZhong ePSU controller board configuration

# SPDX-License-Identifier: Apache-2.0

config BOARD_CIOSZHONG_PSU
	select SOC_STM32H745XX_M7
```

## application/boards/arm/cioszhong_psu/board.yml
```yaml
board:
  name: cioszhong_psu
  full_name: CiosZhong ePSU Controller
  vendor: siemens
  socs:
    - name: stm32h745xx
```

## application/boards/arm/cioszhong_psu/cioszhong_psu_stm32h745xx_m7_defconfig
```kconfig
# SPDX-License-Identifier: Apache-2.0
# CiosZhong ePSU controller — CM7 core

# Enable MPU
CONFIG_ARM_MPU=y

# Enable HW stack protection
CONFIG_HW_STACK_PROTECTION=y

# Enable UART (console)
CONFIG_SERIAL=y

# Console
CONFIG_CONSOLE=y
CONFIG_UART_CONSOLE=y

# Enable GPIO
CONFIG_GPIO=y
```

## lib/http/Kconfig
```kconfig
menu "CiosZhong PSU HTTP options"

config HTTP_DIAG_DEBUG
    bool "Enable HTTP diagnostics debug endpoints"
    default n
    help
      Enables /diag/inject endpoint and related debug features.

endmenu
```
