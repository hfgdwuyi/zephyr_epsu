## CMakeLists.txt
```
cmake_minimum_required(VERSION 3.20.0)

find_package(Zephyr REQUIRED HINTS $ENV{ZEPHYR_BASE})
project(epsu_bootloader)

# Read bootloader version from local FW_VERSION file.
set_property(DIRECTORY APPEND PROPERTY CMAKE_CONFIGURE_DEPENDS
    "${CMAKE_CURRENT_LIST_DIR}/FW_VERSION")
file(READ "${CMAKE_CURRENT_LIST_DIR}/FW_VERSION" FW_VERSION)
string(STRIP "${FW_VERSION}" FW_VERSION)
if(NOT FW_VERSION MATCHES "^[0-9]+\\.[0-9]+\\.[0-9]+$")
    message(FATAL_ERROR "Invalid VERSION format: '${FW_VERSION}'. Expected MAJOR.MINOR.PATCH (e.g. 0.1.0)")
endif()

# Guard against shipping bootloader and application with identical versions.
set(APP_VERSION_FILE "${CMAKE_CURRENT_LIST_DIR}/../application/FW_VERSION")
set(APP_VERSION "unknown")
if(EXISTS "${APP_VERSION_FILE}")
    file(READ "${APP_VERSION_FILE}" APP_VERSION)
    string(STRIP "${APP_VERSION}" APP_VERSION)
    if(FW_VERSION STREQUAL APP_VERSION)
        message(WARNING "Bootloader VERSION (${FW_VERSION}) equals application VERSION (${APP_VERSION}); consider setting distinct versions.")
    endif()
endif()

message(STATUS "Bootloader version: ${FW_VERSION}")
message(STATUS "Application version: ${APP_VERSION}")
target_compile_definitions(app PRIVATE
    BUILD_VERSION="${FW_VERSION}"
    BOOT_VERSION="${FW_VERSION}"
    APP_VERSION="${APP_VERSION}"
    BOOTLOADER=1
)

# Custom linker section for HTTP resource registration
zephyr_linker_sources(SECTIONS sections-rom.ld)

target_include_directories(app PRIVATE
    ${CMAKE_CURRENT_LIST_DIR}/../lib/common
    ${CMAKE_CURRENT_LIST_DIR}/../lib/common/dm
    ${CMAKE_CURRENT_LIST_DIR}/../lib/bsp
    ${CMAKE_CURRENT_LIST_DIR}/../lib/http
)

target_sources(app PRIVATE
    src/main.c
    ../lib/common/dm/dm_core.c
    ../lib/common/dm/dm_ctrl_worker.c
    ../lib/common/dm/dm_diag_worker.c
    ../lib/common/dm/dm_update_worker.c
    ../lib/common/message_queue.c
    ../lib/bsp/bsp_led.c
    ../lib/bsp/bsp_board.c
    ../lib/bsp/bsp_ain.c
    ../lib/bsp/bsp_aout.c
    ../lib/bsp/bsp_dio.c
    ../lib/bsp/bsp_pwm.c
    ../lib/bsp/bsp_wtdg.c
    ../lib/http/http_api.c
    ../lib/http/http_routes.c
    ../lib/http/http_task_echo.c
    ../lib/http/http_task_uptime.c
    ../lib/http/http_task_heartbeat.c
    ../lib/http/http_task_update.c
    ../lib/http/http_task_control.c
    ../lib/http/http_task_diag.c
    ../lib/http/http_task_diag_debug.c
    ../lib/http/http_task_version.c
    ../lib/http/http_task_bootloader.c
)
```

## prj.conf
```kconfig
# Minimal test app — MCUboot dual-slot OTA verification
CONFIG_CONSOLE=y
CONFIG_SERIAL=y
CONFIG_PRINTK=y
CONFIG_BOOTLOADER_MCUBOOT=y
CONFIG_FLASH=y
CONFIG_FLASH_MAP=y
CONFIG_STREAM_FLASH=y
CONFIG_IMG_MANAGER=y
CONFIG_REBOOT=y
CONFIG_POSIX_API=y
CONFIG_STM32H7_BOOT_M4_AT_INIT=n
CONFIG_INIT_ARCH_HW_AT_BOOT=y
CONFIG_HEAP_MEM_POOL_SIZE=32768
# Keep caches disabled — soc_early_init_hook() enables them but
# without MPU configured yet, Cortex-M7 D-Cache causes boot crash
CONFIG_ICACHE=n
CONFIG_DCACHE=n
CONFIG_MAIN_STACK_SIZE=8192
CONFIG_SYSTEM_WORKQUEUE_STACK_SIZE=4096
CONFIG_MCUBOOT_IMGTOOL_SIGN_VERSION="0.0.0"

# Networking (mirrors zephyr_epsu reference config)
CONFIG_NETWORKING=y
CONFIG_NET_IPV4=y
CONFIG_NET_IPV6=y
CONFIG_NET_TCP=y
CONFIG_NET_SOCKETS=y
CONFIG_NET_CONNECTION_MANAGER=y

# Eventfd + poll
CONFIG_EVENTFD=y
CONFIG_ZVFS_EVENTFD_MAX=8
CONFIG_ZVFS_POLL_MAX=32

# Network buffers (reference uses higher values)
CONFIG_NET_PKT_RX_COUNT=16
CONFIG_NET_PKT_TX_COUNT=16
CONFIG_NET_BUF_RX_COUNT=128
CONFIG_NET_BUF_TX_COUNT=128
CONFIG_NET_CONTEXT_NET_PKT_POOL=y
CONFIG_NET_MAX_CONTEXTS=32
CONFIG_NET_MAX_CONN=32

# Static IPv4 + IPv6
CONFIG_NET_CONFIG_SETTINGS=y
CONFIG_NET_CONFIG_NEED_IPV4=y
CONFIG_NET_CONFIG_NEED_IPV6=y
CONFIG_NET_CONFIG_MY_IPV4_ADDR="192.0.2.1"
CONFIG_NET_CONFIG_MY_IPV4_NETMASK="255.255.255.0"
CONFIG_NET_CONFIG_MY_IPV4_GW="192.0.2.2"
CONFIG_NET_CONFIG_MY_IPV6_ADDR="2001:db8::1"
CONFIG_NET_CONFIG_PEER_IPV6_ADDR="2001:db8::2"
CONFIG_NET_DHCPV4=n

# DNS (for hostname resolution in OTA download)
CONFIG_DNS_RESOLVER=y

# HTTP server + client
CONFIG_HTTP_PARSER_URL=y
CONFIG_HTTP_PARSER=y
CONFIG_HTTP_SERVER=y
CONFIG_HTTP_SERVER_VERSION_1=y
CONFIG_HTTP_SERVER_VERSION_2=n
CONFIG_HTTP_CLIENT=y

# TCP tweak for fast consecutive connections
CONFIG_NET_TCP_TIME_WAIT_DELAY=0

# GPIO (LED control)
CONFIG_GPIO=y

# JSON
CONFIG_JSON_LIBRARY=y

# HTTP diag debug endpoint (POST /api/v1/diag/inject)
CONFIG_HTTP_DIAG_DEBUG=y

# Logging
CONFIG_LOG=y
```

## src/main.c
```c
#include <zephyr/kernel.h>
#include <zephyr/sys/printk.h>
#include <zephyr/dfu/mcuboot.h>
#include <zephyr/net/net_config.h>

#include <errno.h>
#include <string.h>

#include "dm_api.h"
#include "bsp_board.h"
#include "bsp_led.h"
#include "http_api.h"

/* ---------- LED blink: 200ms = bootloader mode indicator ---------- */
static struct k_timer led_timer;

static void led_timer_handler(struct k_timer *timer)
{
	ARG_UNUSED(timer);
	ledToggle(SYSTEM_OK_LED_NUM);
}

/* ---------- Main ---------- */
int main(void)
{
	printk("\n===== Bootloader v%s =====\n", BOOT_VERSION);
	printk("[BOOT] Bootloader version: %s\n", BOOT_VERSION);
	boot_write_img_confirmed();
	printk("Bootloader mode, running...\n");

	dm_init();
	boardInit();

	/* Fast blink: 200ms = bootloader mode indicator */
	k_timer_init(&led_timer, led_timer_handler, NULL);
	k_timer_start(&led_timer, K_MSEC(50), K_MSEC(200));

	/* Init network (static IP 192.0.2.1) */
	printk("Initializing network...\n");
	(void)net_config_init_app(NULL, "Initializing network");
	printk("Network ready\n");

	k_sleep(K_SECONDS(2));

	/* Start HTTP server */
	http_api_start();
	printk("Bootloader HTTP server listening on port 80\n");

	uint32_t count = 0;
	while (1) {
		count++;
		printk("Bootloader v%s Alive: %u\n", BOOT_VERSION, count);
		k_sleep(K_SECONDS(3));
	}
	return 0;
}
```
