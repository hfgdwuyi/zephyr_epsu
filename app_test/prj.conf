## CMakeLists.txt
```
cmake_minimum_required(VERSION 3.20.0)

find_package(Zephyr REQUIRED HINTS $ENV{ZEPHYR_BASE})
project(app_test)

target_sources(app PRIVATE
    src/main.c
    src/ota_update.c
)

# Generate iterable section boundary symbols for OTA HTTP service resources
zephyr_linker_sources(SECTIONS sections-rom.ld)
```

## sysbuild.conf
```
SB_CONFIG_BOOTLOADER_MCUBOOT=y
SB_CONFIG_BOOT_SIGNATURE_TYPE_ECDSA_P256=y
SB_CONFIG_BOOT_SIGNATURE_KEY_FILE="../boot/keys/imgtool_key.pem"
SB_CONFIG_MCUBOOT_MODE_SWAP_USING_OFFSET=y
```

## prj.conf
```kconfig
# Minimal test app — MCUboot dual-slot OTA verification
CONFIG_CONSOLE=y
CONFIG_SERIAL=y
CONFIG_PRINTK=y
CONFIG_BOOTLOADER_MCUBOOT=y
CONFIG_FLASH=y
CONFIG_FLASH_MAP=y
CONFIG_STREAM_FLASH=y
CONFIG_IMG_MANAGER=y
CONFIG_REBOOT=y
CONFIG_POSIX_API=y
CONFIG_STM32H7_BOOT_M4_AT_INIT=n
CONFIG_INIT_ARCH_HW_AT_BOOT=y
CONFIG_HEAP_MEM_POOL_SIZE=32768
# Keep caches disabled — soc_early_init_hook() enables them but
# without MPU configured yet, Cortex-M7 D-Cache causes boot crash
CONFIG_ICACHE=n
CONFIG_DCACHE=n
CONFIG_MAIN_STACK_SIZE=8192
CONFIG_SYSTEM_WORKQUEUE_STACK_SIZE=4096
CONFIG_MCUBOOT_IMGTOOL_SIGN_VERSION="0.0.0"

# Networking (mirrors zephyr_epsu reference config)
CONFIG_NETWORKING=y
CONFIG_NET_IPV4=y
CONFIG_NET_IPV6=y
CONFIG_NET_TCP=y
CONFIG_NET_SOCKETS=y
CONFIG_NET_CONNECTION_MANAGER=y

# Eventfd + poll
CONFIG_EVENTFD=y
CONFIG_ZVFS_EVENTFD_MAX=8
CONFIG_ZVFS_POLL_MAX=32

# Network buffers (reference uses higher values)
CONFIG_NET_PKT_RX_COUNT=16
CONFIG_NET_PKT_TX_COUNT=16
CONFIG_NET_BUF_RX_COUNT=128
CONFIG_NET_BUF_TX_COUNT=128
CONFIG_NET_CONTEXT_NET_PKT_POOL=y
CONFIG_NET_MAX_CONTEXTS=32
CONFIG_NET_MAX_CONN=32

# Static IPv4 + IPv6
CONFIG_NET_CONFIG_SETTINGS=y
CONFIG_NET_CONFIG_NEED_IPV4=y
CONFIG_NET_CONFIG_NEED_IPV6=y
CONFIG_NET_CONFIG_MY_IPV4_ADDR="192.0.2.1"
CONFIG_NET_CONFIG_MY_IPV4_NETMASK="255.255.255.0"
CONFIG_NET_CONFIG_MY_IPV4_GW="192.0.2.2"
CONFIG_NET_CONFIG_MY_IPV6_ADDR="2001:db8::1"
CONFIG_NET_CONFIG_PEER_IPV6_ADDR="2001:db8::2"
CONFIG_NET_DHCPV4=n

# DNS (for hostname resolution in OTA download)
CONFIG_DNS_RESOLVER=y

# HTTP server + client
CONFIG_HTTP_PARSER_URL=y
CONFIG_HTTP_PARSER=y
CONFIG_HTTP_SERVER=y
CONFIG_HTTP_SERVER_VERSION_1=y
CONFIG_HTTP_SERVER_VERSION_2=n
CONFIG_HTTP_CLIENT=y

# TCP tweak for fast consecutive connections
CONFIG_NET_TCP_TIME_WAIT_DELAY=0

# JSON
CONFIG_JSON_LIBRARY=y
```

## src/main.c
```c
#include <zephyr/kernel.h>
#include <zephyr/sys/printk.h>
#include <zephyr/dfu/mcuboot.h>
#include <zephyr/net/http/server.h>
#include <zephyr/net/http/service.h>
#include <zephyr/net/net_ip.h>
#include <zephyr/net/socket.h>
#include <zephyr/net/net_config.h>
#include <zephyr/data/json.h>
#include <zephyr/sys/util.h>
#include <zephyr/sys/reboot.h>

#include <errno.h>
#include <string.h>

#include "ota_update.h"

/* ---------- JSON response headers ---------- */
static const struct http_header json_headers[] = {
	{ .name = "Content-Type",  .value = "application/json"   },
	{ .name = "Cache-Control", .value = "no-store"            },
};

static uint16_t svc_port = 80;

/* ---------- POST /update/start ---------- */
struct start_cmd {
	char uri[160];
};

static const struct json_obj_descr start_cmd_descr[] = {
	JSON_OBJ_DESCR_PRIM(struct start_cmd, uri, JSON_TOK_STRING),
};

static int handle_update_start(struct http_client_ctx *client,
			       enum http_transaction_status status,
			       const struct http_request_ctx *request,
			       struct http_response_ctx *response,
			       void *user_data)
{
	static uint8_t payload[256];
	static size_t cursor;
	static char reply[160];

	ARG_UNUSED(client);
	ARG_UNUSED(user_data);

	if (status == HTTP_SERVER_TRANSACTION_ABORTED ||
	    status == HTTP_SERVER_TRANSACTION_COMPLETE) {
		cursor = 0;
		return 0;
	}

	if ((cursor + request->data_len) > sizeof(payload)) {
		cursor = 0;
		int n = snprintk(reply, sizeof(reply),
			"{\"ok\":false,\"error\":\"too_large\"}\n");
		response->status = 413;
		response->headers = json_headers;
		response->header_count = ARRAY_SIZE(json_headers);
		response->body = reply;
		response->body_len = n;
		response->final_chunk = true;
		return 0;
	}

	memcpy(payload + cursor, request->data, request->data_len);
	cursor += request->data_len;

	if (status != HTTP_SERVER_REQUEST_DATA_FINAL) {
		return 0;
	}

	/* null-terminate for safety */
	if (cursor < sizeof(payload)) {
		payload[cursor] = '\0';
	}

	/* Manual JSON parsing: extract "uri" value from {"uri":"..."} */
	char uri[160] = {0};
	const char *key = strstr((const char *)payload, "\"uri\"");
	if (key != NULL) {
		const char *val_start = strchr(key + 5, '"');
		if (val_start != NULL) {
			val_start++;
			const char *val_end = strchr(val_start, '"');
			if (val_end != NULL) {
				size_t len = (size_t)(val_end - val_start);
				if (len >= sizeof(uri)) {
					len = sizeof(uri) - 1;
				}
				memcpy(uri, val_start, len);
				uri[len] = '\0';
			}
		}
	}
	cursor = 0;

	printk("OTA parsed uri='%s'\n", uri);

	if (uri[0] == '\0') {
		int n = snprintk(reply, sizeof(reply),
			"{\"ok\":false,\"error\":\"bad_json\"}\n");
		response->status = 400;
		response->headers = json_headers;
		response->header_count = ARRAY_SIZE(json_headers);
		response->body = reply;
		response->body_len = n;
		response->final_chunk = true;
		return 0;
	}

	int rc = ota_update_start(uri);
	if (rc != 0) {
		int n = snprintk(reply, sizeof(reply),
			"{\"ok\":false,\"error\":\"ota_failed\",\"rc\":%d}\n", rc);
		response->status = 500;
		response->headers = json_headers;
		response->header_count = ARRAY_SIZE(json_headers);
		response->body = reply;
		response->body_len = n;
		response->final_chunk = true;
		return 0;
	}

	int n = snprintk(reply, sizeof(reply), "{\"ok\":true}\n");
	response->status = 200;
	response->headers = json_headers;
	response->header_count = ARRAY_SIZE(json_headers);
	response->body = reply;
	response->body_len = n;
	response->final_chunk = true;
	return 0;
}

static struct http_resource_detail_dynamic update_start_detail = {
	.common = {
		.type = HTTP_RESOURCE_TYPE_DYNAMIC,
		.bitmask_of_supported_http_methods = BIT(HTTP_POST),
	},
	.cb = handle_update_start,
	.user_data = NULL,
};

/* ---------- GET /update/status ---------- */
static int handle_update_status(struct http_client_ctx *client,
				enum http_transaction_status status,
				const struct http_request_ctx *request,
				struct http_response_ctx *response,
				void *user_data)
{
	static char buf[256];

	ARG_UNUSED(client);
	ARG_UNUSED(request);
	ARG_UNUSED(user_data);

	if (status != HTTP_SERVER_REQUEST_DATA_FINAL) {
		return 0;
	}

	enum ota_state s = ota_get_state();
	int n = snprintk(buf, sizeof(buf),
		"{\"state\":%d,\"progress\":%u,\"error\":%d}\n",
		(int)s, ota_get_progress(), ota_get_error());

	response->status = 200;
	response->headers = json_headers;
	response->header_count = ARRAY_SIZE(json_headers);
	response->body = buf;
	response->body_len = n;
	response->final_chunk = true;
	return 0;
}

static struct http_resource_detail_dynamic update_status_detail = {
	.common = {
		.type = HTTP_RESOURCE_TYPE_DYNAMIC,
		.bitmask_of_supported_http_methods = BIT(HTTP_GET),
	},
	.cb = handle_update_status,
	.user_data = NULL,
};

/* ---------- HTTP Resource registration (must be before SERVICE) ---------- */
HTTP_RESOURCE_DEFINE(update_start, ota_svc, "/update/start", &update_start_detail);
HTTP_RESOURCE_DEFINE(update_status, ota_svc, "/update/status", &update_status_detail);

/* ---------- HTTP Service ---------- */
HTTP_SERVICE_DEFINE(ota_svc, "0.0.0.0", &svc_port, 3, 3, NULL, NULL, NULL);

/* ---------- Main ---------- */
int main(void)
{
	printk("\n===== TestApp Version 1 (OTA) =====\n");
	boot_write_img_confirmed();
	printk("Image confirmed, running...\n");

	/* Init network (static IP 192.0.2.1) */
	printk("Initializing network...\n");
	(void)net_config_init_app(NULL, "Initializing network");
	printk("Network ready\n");

	/* Give network stack time to stabilize before binding */
	k_sleep(K_SECONDS(2));

	/* Start HTTP server */
	int rc = http_server_start();
	if (rc != 0) {
		printk("HTTP server start failed: %d\n", rc);
	} else {
		printk("HTTP server listening on port %u\n", svc_port);
	}

	printk("OTA endpoints: POST /update/start  GET /update/status\n");

	uint32_t count = 0;
	while (1) {
		count++;
		printk("V1 Alive: %u\n", count);
		k_sleep(K_SECONDS(3));
	}
	return 0;
}
```

## src/ota_update.c
```c
#include <zephyr/kernel.h>
#include <zephyr/sys/printk.h>
#include <zephyr/storage/flash_map.h>
#include <zephyr/net/socket.h>
#include <zephyr/net/http/client.h>
#include <zephyr/sys/reboot.h>

#include <errno.h>
#include <string.h>

#include "ota_update.h"

/*
 * SWAP_USING_OFFSET: the first sector (128KB) of the secondary slot is
 * reserved for swap operations. The image must start at offset 0x20000.
 */
#define IMAGE_OFFSET  0x20000
#define SECTOR_SZ     0x20000

/* MCUboot image header magic */
#define IMAGE_MAGIC 0x96f3b83d

/* MCUboot image header (first 32 bytes) */
struct __attribute__((packed)) mcuboot_hdr {
	uint32_t ih_magic;
	uint32_t ih_load_addr;
	uint16_t ih_hdr_size;
	uint16_t ih_protect_tlv_size;
	uint32_t ih_img_size;
	uint32_t ih_flags;
	struct {
		uint8_t  major;
		uint8_t  minor;
		uint16_t revision;
		uint32_t build_num;
	} ih_ver;
	uint32_t _pad1;
};

static enum ota_state state = OTA_IDLE;
static int ota_error;
static uint8_t ota_progress;

enum ota_state ota_get_state(void) { return state; }
int ota_get_error(void) { return ota_error; }
uint8_t ota_get_progress(void) { return ota_progress; }

/* Flash write block size for STM32H7 (256-bit / 32-byte alignment) */
#define FLASH_ALIGN 32

/* Per-download context */
struct dl_ctx {
	const struct flash_area *fa;
	uint32_t offset;
	uint32_t max_offset;
	uint8_t  buf[FLASH_ALIGN];
	uint8_t  buf_pos;
};

static int dl_flush(struct dl_ctx *ctx, bool final)
{
	if (ctx->buf_pos == 0) {
		return 0;
	}

	uint8_t aligned[FLASH_ALIGN];
	memcpy(aligned, ctx->buf, ctx->buf_pos);
	memset(aligned + ctx->buf_pos, 0xFF, FLASH_ALIGN - ctx->buf_pos);

	uint32_t wr_addr = ctx->offset - ctx->buf_pos;
	wr_addr &= ~(FLASH_ALIGN - 1);

	int rc = flash_area_write(ctx->fa, wr_addr, aligned, FLASH_ALIGN);
	if (rc != 0) {
		printk("OTA: flash flush err %d at 0x%x\n", rc, wr_addr);
		return rc;
	}

	if (final) {
		ctx->offset = wr_addr + ctx->buf_pos;
	}
	ctx->buf_pos = 0;
	return 0;
}

static int download_cb(struct http_response *rsp, enum http_final_call final,
		       void *user_data)
{
	struct dl_ctx *ctx = (struct dl_ctx *)user_data;

	if (ctx == NULL || rsp == NULL) {
		return -EINVAL;
	}

	if (rsp->body_frag_len > 0 && rsp->body_frag_start != NULL) {
		const uint8_t *data = rsp->body_frag_start;
		uint32_t remaining = (uint32_t)rsp->body_frag_len;

		while (remaining > 0 && ctx->offset < ctx->max_offset) {
			uint32_t space_until_max = ctx->max_offset - ctx->offset;
			uint8_t space = FLASH_ALIGN - ctx->buf_pos;
			uint32_t copy = (remaining < space) ? remaining : space;
			if (copy > space_until_max) {
				copy = space_until_max;
			}
			memcpy(ctx->buf + ctx->buf_pos, data, copy);
			ctx->buf_pos += (uint8_t)copy;
			ctx->offset += copy;
			data += copy;
			remaining -= copy;

			if (ctx->buf_pos == FLASH_ALIGN) {
				uint32_t wr_addr = ctx->offset - FLASH_ALIGN;
				int rc = flash_area_write(ctx->fa, wr_addr,
							  ctx->buf, FLASH_ALIGN);
				if (rc != 0) {
					printk("OTA: flash write err %d at 0x%x\n",
					       rc, wr_addr);
					return rc;
				}
				ctx->buf_pos = 0;
			}
		}

		if (ctx->offset >= ctx->max_offset) {
			printk("OTA: max_offset reached, truncating\n");
		}

		if (rsp->content_length > 0) {
			uint32_t downloaded = ctx->offset - IMAGE_OFFSET;
			ota_progress = (uint8_t)((downloaded * 100) /
						(uint32_t)rsp->content_length);
			if (ota_progress % 20 == 0) {
				printk("OTA: download %u%%\n", ota_progress);
			}
		}
	}

	if (final == HTTP_DATA_FINAL) {
		int rc = dl_flush(ctx, true);
		if (rc != 0) {
			return rc;
		}
	}

	return 0;
}

int ota_update_start(const char *uri)
{
	if (state == OTA_DOWNLOADING) {
		return -EBUSY;
	}

	if (uri == NULL || uri[0] == '\0') {
		state = OTA_FAILED;
		ota_error = -EINVAL;
		return -EINVAL;
	}

	printk("OTA: starting download from %s\n", uri);

	state = OTA_DOWNLOADING;
	ota_progress = 0;
	ota_error = 0;

	const struct flash_area *fa = NULL;
	int rc = flash_area_open(PARTITION_ID(slot1_partition), &fa);
	if (rc != 0) {
		printk("OTA: flash_area_open slot1 err %d\n", rc);
		goto fail;
	}

	rc = flash_area_erase(fa, 0, fa->fa_size);
	if (rc != 0) {
		printk("OTA: flash_area_erase err %d\n", rc);
		flash_area_close(fa);
		goto fail;
	}

	printk("OTA: image starts at slot offset 0x%x, slot size 0x%x\n",
	       IMAGE_OFFSET, fa->fa_size);

	/* ---------- Parse URI ---------- */
	const char *host_start = NULL;
	if (strncmp(uri, "http://", 7) == 0) {
		host_start = uri + 7;
	} else {
		host_start = uri;
	}

	char host[64];
	const char *path_start = strchr(host_start, '/');
	size_t host_len;
	if (path_start != NULL) {
		host_len = (size_t)(path_start - host_start);
	} else {
		host_len = strlen(host_start);
	}
	if (host_len > sizeof(host) - 1) {
		host_len = sizeof(host) - 1;
	}
	memcpy(host, host_start, host_len);
	host[host_len] = '\0';

	const char *path = (path_start != NULL) ? path_start : "/";

	char port_str[8] = "80";
	const char *colon = strchr(host, ':');
	if (colon != NULL) {
		size_t port_len = host_len - (size_t)(colon - host) - 1;
		if (port_len > 0 && port_len < sizeof(port_str)) {
			memcpy(port_str, colon + 1, port_len);
			port_str[port_len] = '\0';
		}
		host[colon - host] = '\0';
	}

	printk("OTA: host=%s port=%s path=%s\n", host, port_str, path);

	/* ---------- Connect ---------- */
	struct zsock_addrinfo hints = {
		.ai_family = AF_INET,
		.ai_socktype = SOCK_STREAM,
	};
	struct zsock_addrinfo *res = NULL;

	rc = zsock_getaddrinfo(host, port_str, &hints, &res);
	if (rc != 0 || res == NULL) {
		printk("OTA: getaddrinfo err %d\n", rc);
		flash_area_close(fa);
		goto fail;
	}

	int sock = zsock_socket(res->ai_family, res->ai_socktype,
				res->ai_protocol);
	if (sock < 0) {
		printk("OTA: socket err %d\n", sock);
		zsock_freeaddrinfo(res);
		flash_area_close(fa);
		goto fail;
	}

	rc = zsock_connect(sock, res->ai_addr, res->ai_addrlen);
	zsock_freeaddrinfo(res);
	if (rc < 0) {
		printk("OTA: connect err %d\n", rc);
		zsock_close(sock);
		flash_area_close(fa);
		goto fail;
	}

	printk("OTA: connected to %s:%s\n", host, port_str);

	/* ---------- HTTP GET ---------- */
	struct dl_ctx dl_ctx = {
		.fa = fa,
		.offset = IMAGE_OFFSET,
		.max_offset = fa->fa_size - SECTOR_SZ,
		.buf_pos = 0,
	};

	static uint8_t recv_buf[4096];
	struct http_request req;
	memset(&req, 0, sizeof(req));
	req.method = HTTP_GET;
	req.url = path;
	req.host = host;
	req.port = port_str;
	req.protocol = "HTTP/1.1";
	req.recv_buf = recv_buf;
	req.recv_buf_len = sizeof(recv_buf);
	req.response = download_cb;

	rc = http_client_req(sock, &req, 30000, &dl_ctx);
	zsock_close(sock);
	if (rc < 0 && rc != -ECONNRESET) {
		printk("OTA: http_client_req err %d\n", rc);
		flash_area_close(fa);
		goto fail;
	}
	uint32_t total = dl_ctx.offset;
	flash_area_close(fa);

	if (total == IMAGE_OFFSET) {
		printk("OTA: downloaded 0 bytes\n");
		ota_error = -ENODATA;
		goto fail;
	}

	printk("OTA: downloaded %u bytes (image %u bytes)\n",
	       total, total - IMAGE_OFFSET);

	/* ---------- Verify MCUboot header ---------- */
	state = OTA_VERIFYING;
	rc = flash_area_open(PARTITION_ID(slot1_partition), &fa);
	if (rc != 0) {
		printk("OTA: re-open slot1 for verify err %d\n", rc);
		goto fail;
	}

	struct mcuboot_hdr hdr;
	rc = flash_area_read(fa, IMAGE_OFFSET, &hdr, sizeof(hdr));
	flash_area_close(fa);

	if (rc != 0) {
		printk("OTA: read header err %d\n", rc);
		goto fail;
	}

	if (hdr.ih_magic != IMAGE_MAGIC) {
		printk("OTA: bad magic 0x%08x (expected 0x%08x)\n",
		       hdr.ih_magic, IMAGE_MAGIC);
		ota_error = -EBADMSG;
		goto fail;
	}

	printk("OTA: image v%u.%u.%u size=%u\n",
	       hdr.ih_ver.major, hdr.ih_ver.minor,
	       hdr.ih_ver.revision, hdr.ih_img_size);

	/* ---------- Write MCUboot trailer ----------
	 * The signed image may be padded to fill the entire slot, which
	 * overwrites the trailer area with non-0xFF data. Re-erase the
	 * last 128KB sector before writing trailer.
	 *
	 * Trailer layout (SWAP_USING_OFFSET, 32-byte alignment):
	 *   fa_size - 16:        magic (16 bytes)
	 *   ALIGN_DOWN(magic-32): image_ok
	 *   image_ok - 32:       copy_done
	 *   copy_done - 32:      swap_info
	 */
	state = OTA_APPLYING;

	#define BOOT_MAGIC_SZ       16
	#define BOOT_MAX_ALIGN      32
	#define BOOT_SWAP_TYPE_TEST 0x01

	/* MCUboot trailer magic for BOOT_MAX_ALIGN=32.
	 * struct { uint16_t align; uint8_t magic[14]; } = {32, {0x2d,0xe1,...}}
	 * On little-endian ARM: 0x20,0x00 then 14 magic bytes.
	 */
	static const uint8_t boot_img_magic[16] = {
		0x20, 0x00, 0x2d, 0xe1, 0x5d, 0x29, 0x41, 0x0b,
		0x8d, 0x77, 0x67, 0x9c, 0x11, 0x0f, 0x1f, 0x8a
	};

	rc = flash_area_open(PARTITION_ID(slot1_partition), &fa);
	if (rc != 0) {
		printk("OTA: open slot1 for trailer err %d\n", rc);
		goto fail;
	}

	uint32_t fa_sz = fa->fa_size;

	/* Erase last 128KB sector to clear overwritten trailer area */
	uint32_t trailer_erase_off = fa_sz - SECTOR_SZ;
	rc = flash_area_erase(fa, trailer_erase_off, SECTOR_SZ);
	if (rc != 0) {
		printk("OTA: trailer sector erase err %d at 0x%x\n",
		       rc, trailer_erase_off);
		flash_area_close(fa);
		goto fail;
	}

	uint32_t magic_off = fa_sz - BOOT_MAGIC_SZ;
	uint32_t swap_info_off = ((magic_off - BOOT_MAX_ALIGN) / BOOT_MAX_ALIGN)
				 * BOOT_MAX_ALIGN; /* image_ok */
	swap_info_off -= BOOT_MAX_ALIGN; /* copy_done */
	swap_info_off -= BOOT_MAX_ALIGN; /* swap_info */
	uint32_t magic_pad_off = (magic_off / BOOT_MAX_ALIGN) * BOOT_MAX_ALIGN;

	printk("OTA: trailer magic@0x%x swap@0x%x\n", magic_off, swap_info_off);

	/* Write magic (32-byte aligned block, magic at end) */
	uint8_t magic_buf[32];
	memset(magic_buf, 0xFF, sizeof(magic_buf));
	memcpy(magic_buf + (magic_off - magic_pad_off), boot_img_magic, 16);

	rc = flash_area_write(fa, magic_pad_off, magic_buf, 32);
	if (rc != 0) {
		printk("OTA: write magic err %d at 0x%x\n", rc, magic_pad_off);
		flash_area_close(fa);
		goto fail;
	}

	/* Write swap_info = TEST (1 byte padded to 32) */
	uint8_t swap_buf[32];
	memset(swap_buf, 0xFF, sizeof(swap_buf));
	swap_buf[0] = BOOT_SWAP_TYPE_TEST;

	rc = flash_area_write(fa, swap_info_off, swap_buf, 32);
	if (rc != 0) {
		printk("OTA: write swap_info err %d at 0x%x\n", rc, swap_info_off);
		flash_area_close(fa);
		goto fail;
	}

	/* Write swap_size = 0 to ensure swap starts from offset 0.
	 * swap_size_off = swap_info_off - 2 * BOOT_MAX_ALIGN (SWAP_USING_OFFSET)
	 */
	uint32_t swap_size_off = swap_info_off - 2 * BOOT_MAX_ALIGN;
	uint8_t sz_buf[32];
	memset(sz_buf, 0xFF, sizeof(sz_buf));
	uint32_t zero = 0;
	memcpy(sz_buf, &zero, sizeof(zero));

	rc = flash_area_write(fa, swap_size_off, sz_buf, 32);
	flash_area_close(fa);
	if (rc != 0) {
		printk("OTA: write swap_size err %d at 0x%x\n", rc, swap_size_off);
		goto fail;
	}

	printk("OTA: trailer written\n");

	/* ---------- Reboot ---------- */
	state = OTA_REBOOT_PENDING;
	printk("OTA: upgrade requested, rebooting in 2s...\n");
	k_sleep(K_SECONDS(2));
	sys_reboot(SYS_REBOOT_COLD);

	return 0;

fail:
	state = OTA_FAILED;
	if (ota_error == 0) {
		ota_error = rc;
	}
	return ota_error;
}
```

## src/ota_update.h
```c
#ifndef OTA_UPDATE_H
#define OTA_UPDATE_H

#include <stdint.h>

/* OTA update states */
enum ota_state {
	OTA_IDLE = 0,
	OTA_DOWNLOADING,
	OTA_VERIFYING,
	OTA_APPLYING,
	OTA_REBOOT_PENDING,
	OTA_FAILED,
};

/* Start firmware download from URI and write to slot1 */
int ota_update_start(const char *uri);

/* Get current OTA state, error code, and progress percentage */
enum ota_state ota_get_state(void);
int ota_get_error(void);
uint8_t ota_get_progress(void);

#endif /* OTA_UPDATE_H */
```
